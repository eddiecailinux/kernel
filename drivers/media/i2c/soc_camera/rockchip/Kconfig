## drivers/media/i2c/soc_camera/rockchip/Kconfig
```kconfig
config VIDEO_ov5695
	tristate "ov5695 driver adapt to rockchip cif isp platform"
	depends on VIDEO_V4L2 && VIDEO_RK_CIF_ISP10 && I2C
	default n
	---help---
	  This is ov2710 camera driver adapt to rockchip cif isp platform.
```

## drivers/media/platform/cameric/Kconfig
```kconfig
config VIDEO_CAMERIC
	tristate "Cameric Subsystem driver"
	depends on VIDEO_V4L2 && VIDEO_V4L2_SUBDEV_API
	depends on OF && COMMON_CLK
	select VIDEOBUF2_DMA_CONTIG
	select V4L2_MEM2MEM_DEV
	help
	  Say Y here to enable camera host interface devices for Cameric
```
